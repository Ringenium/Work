//=========================================================
// src/Demo_main.c: generated by Hardware Configurator
//
// This file will be updated when saving a document.
// leave the sections inside the "$[...]" comment tags alone
// or they will be overwritten!!
//=========================================================
//#define DEMO
//-----------------------------------------------------------------------------
// Includes
//-----------------------------------------------------------------------------
#include <SI_EFM8BB3_Register_Enums.h>                  // SFR declarations
#include "InitDevice.h"
// $[Generated Includes]
// [Generated Includes]$

void
delay (uint32_t count)
{
  uint32_t n = 0;
  while (n < count)
    n++;
}

//-----------------------------------------------------------------------------
// SiLabs_Startup() Routine
// ----------------------------------------------------------------------------
// This function is called immediately after reset, before the initialization
// code is run in SILABS_STARTUP.A51 (which runs before main() ). This is a
// useful place to disable the watchdog timer, which is enable by default
// and may trigger before main() in some instances.
//-----------------------------------------------------------------------------
void
SiLabs_Startup (void)
{
  // $[SiLabs Startup]
  // [SiLabs Startup]$
}

//-----------------------------------------------------------------------------
// main() Routine

// ----------------------------------------------------------------------------
int
main (void)
{
  // Call hardware initialization routine
  enter_DefaultMode_from_RESET ();

  while (1)
    {

#ifdef DEMO

      //Status

      uint8_t i = 0;

      for (i = 0; i < 2; i++)
        {
          P3 = P3_B1__LOW;
          delay (10000);
          P3 = P3_B1__HIGH;
          delay (10000);
          P3 = P3_B1__LOW;
        }

      //Signal

      SFRPAGE = 0x20;

      P3 = P3_B0__LOW;
      delay (10000);
      P2 = P2_B6__LOW;
      delay (10000);
      P2 = P2_B5__LOW;
      delay (10000);

      //Battery

      for (i = 0; i < 8; i++)
        {
          P2 = P2_B4__LOW;
          delay (10000);
          P2 = P2_B4__HIGH;
          delay (10000);
        }

      //OFF/TPS_ON

      P2 = P2_B3__HIGH|P2_B4__HIGH | P2_B5__HIGH | P2_B6__HIGH;

      SFRPAGE = 0x20;

      P3 = P3_B1__HIGH | P3_B0__HIGH;

      delay (500000);
      /*

       delay(100000);

       P2 = P2_B3__HIGH | P2_B4__HIGH | P2_B5__HIGH | P2_B6__HIGH;

       P3=P3_B3__HIGH;

       delay(100000);

       P2 = P2_B3__LOW | P2_B4__LOW | P2_B5__LOW | P2_B6__LOW;

       P3=P3_B3__LOW;
       */
#endif

// $[Generated Run-time code]
// [Generated Run-time code]$
    }
}
